/* DO NOT EDIT THIS FILE.  IT IS AUTOMATICALLY GENERATED. */

RUN_TEST(test_llap_extract_ddp_packet);

RUN_TEST(test_lap_registry_ordering);
RUN_TEST(test_lap_registry_zone_cache);

RUN_TEST(test_newbuf);
RUN_TEST(test_buf_l2hdr_shenanigans);
RUN_TEST(test_buf_ddp_setup);
RUN_TEST(test_buf_append);

RUN_TEST(test_ddp_append);

RUN_TEST(test_zip_qry_creation);
RUN_TEST(zip_tuple_reading);

RUN_TEST(test_aarp_table);

RUN_TEST(test_routing_table_basics);
RUN_TEST(test_routing_table_distance_and_replacement);
RUN_TEST(test_routing_table_route_selection_ordering);
RUN_TEST(test_routing_table_aging);
RUN_TEST(test_routing_table_events);

RUN_TEST(test_zip_table_networks);
RUN_TEST(test_zip_table_zones);
RUN_TEST(test_zip_table_completion);
RUN_TEST(test_zip_table_stats);

RUN_TEST(test_tests);

RUN_TEST(test_event_add_callback);
RUN_TEST(test_event_fire);

RUN_TEST(test_pstring_round_tripping);

