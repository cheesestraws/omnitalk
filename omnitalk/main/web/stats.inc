/* DO NOT EDIT THIS FILE.  IT IS AUTOMATICALLY GENERATED. */

COUNTER_FIELD(req, uptime_seconds, uptime_seconds, "", "system uptime in seconds");
COUNTER_FIELD(req, mem_all_allocs, mem_all_allocs, "", "all heap allocations");
COUNTER_FIELD(req, mem_all_frees, mem_all_frees, "", "all heap frees");
GAUGE_FIELD(req, mem_total_free_bytes__type_heap, mem_total_free_bytes, "type=\"heap\"", "total free bytes");
GAUGE_FIELD(req, mem_minimum_free_bytes__type_heap, mem_minimum_free_bytes, "type=\"heap\"", "minimum free bytes we've seen so far");
GAUGE_FIELD(req, mem_largest_free_block__type_heap, mem_largest_free_block, "type=\"heap\"", "largest available free block");
GAUGE_FIELD(req, mem_total_free_bytes__type_dma, mem_total_free_bytes, "type=\"dma\"", "total free bytes");
GAUGE_FIELD(req, mem_minimum_free_bytes__type_dma, mem_minimum_free_bytes, "type=\"dma\"", "minimum free bytes we've seen so far");
GAUGE_FIELD(req, mem_largest_free_block__type_dma, mem_largest_free_block, "type=\"dma\"", "largest available free block");
COUNTER_FIELD(req, transport_in_octets__transport_localtalk, transport_in_octets, "transport=\"localtalk\"", "");
COUNTER_FIELD(req, transport_out_octets__transport_localtalk, transport_out_octets, "transport=\"localtalk\"", "");
COUNTER_FIELD(req, transport_in_frames__transport_localtalk, transport_in_frames, "transport=\"localtalk\"", "");
COUNTER_FIELD(req, transport_out_frames__transport_localtalk, transport_out_frames, "transport=\"localtalk\"", "");
COUNTER_FIELD(req, transport_in_errors__transport_localtalk__err_frame_too_long, transport_in_errors, "transport=\"localtalk\",err=\"frame too long\"", "");
COUNTER_FIELD(req, transport_in_errors__transport_localtalk__err_frame_too_short, transport_in_errors, "transport=\"localtalk\",err=\"frame too short\"", "");
COUNTER_FIELD(req, transport_in_errors__transport_localtalk__err_bad_crc, transport_in_errors, "transport=\"localtalk\",err=\"bad crc\"", "");
COUNTER_FIELD(req, transport_in_errors__transport_localtalk__err_framing_error, transport_in_errors, "transport=\"localtalk\",err=\"framing error\"", "");
COUNTER_FIELD(req, transport_in_errors__transport_localtalk__err_frame_abort, transport_in_errors, "transport=\"localtalk\",err=\"frame abort\"", "");
COUNTER_FIELD(req, transport_in_errors__transport_localtalk__err_lap_queue_full, transport_in_errors, "transport=\"localtalk\",err=\"lap queue full\"", "");
COUNTER_FIELD(req, tashtalk_rx_control_packets_not_forwarded, tashtalk_rx_control_packets_not_forwarded, "", "");
COUNTER_FIELD(req, transport_out_errors__transport_localtalk__err_packet_too_short, transport_out_errors, "transport=\"localtalk\",err=\"packet too short\"", "");
COUNTER_FIELD(req, transport_out_errors__transport_localtalk__err_data_packet_too_short, transport_out_errors, "transport=\"localtalk\",err=\"data packet too short\"", "");
COUNTER_FIELD(req, transport_out_errors__transport_localtalk__err_control_packet_too_long, transport_out_errors, "transport=\"localtalk\",err=\"control packet too long\"", "");
COUNTER_FIELD(req, transport_out_errors__transport_localtalk__err_packet_length_impossible, transport_out_errors, "transport=\"localtalk\",err=\"packet length impossible\"", "");
COUNTER_FIELD(req, transport_out_errors__transport_localtalk__err_packet_length_inconsistent, transport_out_errors, "transport=\"localtalk\",err=\"packet length inconsistent\"", "");
COUNTER_FIELD(req, transport_out_errors__transport_localtalk__err_bad_crc, transport_out_errors, "transport=\"localtalk\",err=\"bad crc\"", "");
COUNTER_FIELD(req, transport_out_errors__transport_localtalk__err_no_room_for_crc_in_buffer, transport_out_errors, "transport=\"localtalk\",err=\"no room for crc in buffer\"", "");
COUNTER_FIELD(req, transport_in_octets__transport_ltoudp, transport_in_octets, "transport=\"ltoudp\"", "");
COUNTER_FIELD(req, transport_out_octets__transport_ltoudp, transport_out_octets, "transport=\"ltoudp\"", "");
COUNTER_FIELD(req, transport_in_frames__transport_ltoudp, transport_in_frames, "transport=\"ltoudp\"", "");
COUNTER_FIELD(req, transport_out_frames__transport_ltoudp, transport_out_frames, "transport=\"ltoudp\"", "");
COUNTER_FIELD(req, transport_in_errors__transport_ltoudp__err_recv_failed, transport_in_errors, "transport=\"ltoudp\",err=\"recv failed\"", "");
COUNTER_FIELD(req, transport_in_errors__transport_ltoudp__err_packet_too_long, transport_in_errors, "transport=\"ltoudp\",err=\"packet too long\"", "");
COUNTER_FIELD(req, transport_in_errors__transport_ltoudp__err_lap_queue_full, transport_in_errors, "transport=\"ltoudp\",err=\"lap queue full\"", "");
COUNTER_FIELD(req, transport_out_errors__transport_ltoudp__err_send_failed, transport_out_errors, "transport=\"ltoudp\",err=\"send failed\"", "");
COUNTER_FIELD(req, transport_in_octets__transport_b2udp, transport_in_octets, "transport=\"b2udp\"", "");
COUNTER_FIELD(req, transport_out_octets__transport_b2udp, transport_out_octets, "transport=\"b2udp\"", "");
COUNTER_FIELD(req, transport_in_frames__transport_b2udp, transport_in_frames, "transport=\"b2udp\"", "");
COUNTER_FIELD(req, transport_out_frames__transport_b2udp, transport_out_frames, "transport=\"b2udp\"", "");
COUNTER_FIELD(req, transport_in_errors__transport_b2udp__err_recvfrom_failed, transport_in_errors, "transport=\"b2udp\",err=\"recvfrom failed\"", "");
COUNTER_FIELD(req, transport_in_errors__transport_b2udp__err_frame_too_short, transport_in_errors, "transport=\"b2udp\",err=\"frame too short\"", "");
COUNTER_FIELD(req, transport_in_errors__transport_b2udp__err_invalid_source_MAC, transport_in_errors, "transport=\"b2udp\",err=\"invalid source MAC\"", "");
COUNTER_FIELD(req, transport_in_errors__transport_b2udp__err_lap_queue_full, transport_in_errors, "transport=\"b2udp\",err=\"lap queue full\"", "");
COUNTER_FIELD(req, transport_out_errors__transport_b2udp__err_frame_too_short, transport_out_errors, "transport=\"b2udp\",err=\"frame too short\"", "");
COUNTER_FIELD(req, transport_out_errors__transport_b2udp__err_invalid_dst_MAC, transport_out_errors, "transport=\"b2udp\",err=\"invalid dst MAC\"", "");
COUNTER_FIELD(req, transport_out_errors__transport_b2udp__err_sendto_failed, transport_out_errors, "transport=\"b2udp\",err=\"sendto failed\"", "");
COUNTER_FIELD(req, transport_in_octets__transport_ethernet, transport_in_octets, "transport=\"ethernet\"", "");
COUNTER_FIELD(req, transport_out_octets__transport_ethernet, transport_out_octets, "transport=\"ethernet\"", "");
COUNTER_FIELD(req, transport_in_frames__transport_ethernet, transport_in_frames, "transport=\"ethernet\"", "");
COUNTER_FIELD(req, transport_out_frames__transport_ethernet, transport_out_frames, "transport=\"ethernet\"", "");
COUNTER_FIELD(req, eth_recv_elap_frames, eth_recv_elap_frames, "", "ethernet: received ELAP frames (raw count)");
COUNTER_FIELD(req, eth_recv_aarp_frames, eth_recv_aarp_frames, "", "ethernet: received AARP frames (raw count)");
COUNTER_FIELD(req, transport_in_errors__transport_ethernet__err_lap_queue_full, transport_in_errors, "transport=\"ethernet\",err=\"lap queue full\"", "");
COUNTER_FIELD(req, lap_registry_registered_laps, lap_registry_registered_laps, "", "");
COUNTER_FIELD(req, ddp_out_errors__err_no_route_for_network, ddp_out_errors, "err=\"no route for network\"", "");
COUNTER_FIELD(req, controlplane_inbound_queue_full, controlplane_inbound_queue_full, "", "");
COUNTER_FIELD(req, rtmp_update_packets, rtmp_update_packets, "", "");
COUNTER_FIELD(req, rtmp_errors__err_packet_too_short, rtmp_errors, "err=\"packet too short\"", "");
COUNTER_FIELD(req, rtmp_errors__err_wrong_id_len, rtmp_errors, "err=\"wrong id len\"", "");
COUNTER_FIELD(req, zip_out_queries, zip_out_queries, "", "");
COUNTER_FIELD(req, zip_out_errors__err_ddp_send_failed, zip_out_errors, "err=\"ddp send failed\"", "");
COUNTER_FIELD(req, zip_in_replies__kind_nonextended, zip_in_replies, "kind=\"nonextended\"", "");
COUNTER_FIELD(req, zip_in_replies__kind_extended, zip_in_replies, "kind=\"extended\"", "");
